## drivers/input/touchscreen/focaltech_touch_ft8201p/Kconfig
```kconfig
#
# Focaltech Touchscreen driver configuration
#

config TOUCHSCREEN_FTS_SPI
    tristate "Focaltech Touchscreen FT8201P"
    default m
    help
      Say Y here if you have Focaltech touch panel.
      If unsure, say N.
```

## drivers/input/touchscreen/jadard/Kconfig
```kconfig
#
# Jadard Touchscreen driver configuration
#

config TOUCHSCREEN_JADARD_MODULE
	tristate "Jadard chipset module fuction"
	depends on TOUCHSCREEN_JADARD_CHIPSET
	help
	  This switch whether to compile into a kernel module.
config TOUCHSCREEN_JADARD_IC_JD9366T
	tristate "Jadard chipset of JD9366T"
	depends on TOUCHSCREEN_JADARD_CHIPSET
	help
	  This enables support for Jadard chipset of JD9366T.


config JD_DB
	tristate "Jadard driver test over Dragon Board"
	depends on TOUCHSCREEN_JADARD_CHIPSET
	help
	  This enables support for Jadard driver test over Dragon Board.

config JD_FB
	tristate "Jadard driver suspend/resume event by system FB"
	depends on TOUCHSCREEN_JADARD_CHIPSET
	help
	  This enables support for Jadard driver suspend/resume event by system FB.

config JD_HID
	tristate "Jadard HID over I2C/SPI function"
	depends on TOUCHSCREEN_JADARD_CHIPSET
	help
	  This enables support for Jadard HID over I2C/SPI.
```

## drivers/misc/hailort/Kconfig
```kconfig
# SPDX-License-Identifier: GPL-2.0-only
menu "Hailo RT H8 M2"

config HAILORT_PCIE
	tristate "Hailo RT M.2 PCIE driver"
	depends on PCIE_BUS_DEFAULT
	help
	  Hailo RT model 8, M.2 AI accelerator.
	  version 4.18.0
	  Driver ported by Raphael Kim.

endmenu
```

## drivers/net/wireless/aic8800_usb/Kconfig
```kconfig
config AIC_USB_WLAN_SUPPORT
	bool "AIC USB wireless Support"
	default n
	help
	  This is support for aic wireless chip.

if AIC_USB_WLAN_SUPPORT
source "drivers/net/wireless/aic8800_usb/aic8800_fdrv/Kconfig"
source "drivers/net/wireless/aic8800_usb/aic_load_fw/Kconfig"
endif
```

## drivers/spi/spi-multi-io/Kconfig
```kconfig
# SPDX-License-Identifier: GPL-2.0-only
#
# SPI Multi-IO driver configuration
#

config SPI_MULTI_IO
	tristate "SPI Multi-IO (DI/DO/AI/AO) support"
	depends on SPI
	help
	  SPI-to-multi-interface driver supporting two module types
	  over a single chip-select SPI bus:

	    Type1 - 8x Digital Input (DI) + 8x Digital Output (DO)
	    Type2 - 4x Analog Input (AI) + 2x Analog Output (AO)

	  Modules share one SPI bus and one CS line, differentiated
	  by assigned addresses. Features:
	    - Automatic module discovery and address assignment
	    - sysfs interface for DI/DO/AI/AO access
	    - Optional power-gpios for module power cycling
	      to guarantee reliable scan
	    - Power management (suspend/resume with state restore)

	  Device tree compatible: "hqvt,spi-multi-io"

	  Say M here to build as a module (spi_multi_io.ko).
```
