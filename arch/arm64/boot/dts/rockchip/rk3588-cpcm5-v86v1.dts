// SPDX-License-Identifier: (GPL-2.0+ OR MIT)
/*
 * Copyright (c) 2021 Rockchip Electronics Co., Ltd.
 *
 */

/dts-v1/;

#include "dt-bindings/usb/pd.h"
#include "rk3588.dtsi"
#include <dt-bindings/gpio/gpio.h>
#include <dt-bindings/pwm/pwm.h>
#include <dt-bindings/pinctrl/rockchip.h>
#include <dt-bindings/input/rk-input.h>
#include <dt-bindings/display/drm_mipi_dsi.h>
#include <dt-bindings/display/rockchip_vop.h>
#include <dt-bindings/sensor-dev.h>
#include "rk3588-rk806-single.dtsi"

/ {
	model = "RK3588 CoolPi CM5 EVB Board";
	compatible = "rockchip,rk3588-core", "rockchip,rk3588";
	
	aliases {
		mmc0 = &sdhci;
		mmc1 = &sdio;
		mmc2 = &sdmmc;
		serial0 = &uart2;
		serial1 = &uart9;
		serial2 = &uart6;
		serial3 = &uart3;
		serial4 = &uart4;
		serial5 = &uart5;
		serial6 = &uart0;
		serial7 = &uart7;
		serial8 = &uart8;
		serial9 = &uart1;
	};

	cspmu: cspmu@fd10c000 {
		compatible = "rockchip,cspmu";
		reg = <0x0 0xfd10c000 0x0 0x1000>,
		      <0x0 0xfd10d000 0x0 0x1000>,
		      <0x0 0xfd10e000 0x0 0x1000>,
		      <0x0 0xfd10f000 0x0 0x1000>,
		      <0x0 0xfd12c000 0x0 0x1000>,
		      <0x0 0xfd12d000 0x0 0x1000>,
		      <0x0 0xfd12e000 0x0 0x1000>,
		      <0x0 0xfd12f000 0x0 0x1000>;
	};

	debug: debug@fd104000 {
		compatible = "rockchip,debug";
		reg = <0x0 0xfd104000 0x0 0x1000>,
		      <0x0 0xfd105000 0x0 0x1000>,
		      <0x0 0xfd106000 0x0 0x1000>,
		      <0x0 0xfd107000 0x0 0x1000>,
		      <0x0 0xfd124000 0x0 0x1000>,
		      <0x0 0xfd125000 0x0 0x1000>,
		      <0x0 0xfd126000 0x0 0x1000>,
		      <0x0 0xfd127000 0x0 0x1000>;
	};

	fiq_debugger: fiq-debugger {
		compatible = "rockchip,fiq-debugger";
		rockchip,serial-id = <9>;
		rockchip,wake-irq = <0>;
		/* If enable uart uses irq instead of fiq */
		rockchip,irq-mode-enable = <1>;
		rockchip,baudrate = <115200>;  /* Only 115200 and 1500000 */
		interrupts = <GIC_SPI 423 IRQ_TYPE_LEVEL_LOW>;
		pinctrl-names = "default";
		pinctrl-0 = <&uart2m0_xfer>;
		status = "disabled";
	};

	ramoops: ramoops@110000 {
		compatible = "ramoops";
		reg = <0x0 0x110000 0x0 0xf0000>;
		record-size = <0x20000>;
		console-size = <0x80000>;
		ftrace-size = <0x00000>;
		pmsg-size = <0x50000>;
	};

	reserved-memory {
		#address-cells = <2>;
		#size-cells = <2>;
		ranges;

		cma {
			compatible = "shared-dma-pool";
			reusable;
			reg = <0x0 (256 * 0x100000) 0x0 (128 * 0x100000)>;
			linux,cma-default;
		};

		drm_logo: drm-logo@0 {
			compatible = "rockchip,drm-logo";
			reg = <0x0 0x0 0x0 0x0>;
		};
		
		drm_cubic_lut: drm-cubic-lut@0 {
			compatible = "rockchip,drm-cubic-lut";
			reg = <0x0 0x0 0x0 0x0>;
		};
	};
	
	adc_keys: adc-keys {
		compatible = "adc-keys";
		io-channels = <&saradc 1>;
		io-channel-names = "buttons";
		keyup-threshold-microvolt = <1800000>;
		poll-interval = <100>;

		vol-up-key {
			label = "volume up";
			linux,code = <KEY_VOLUMEUP>;
			press-threshold-microvolt = <17000>;
		};
	};

	backlight: backlight {
		compatible = "pwm-backlight";
		brightness-levels = <
			  0  20  20  21  21  22  22  23
			 23  24  24  25  25  26  26  27
			 27  28  28  29  29  30  30  31
			 31  32  32  33  33  34  34  35
			 35  36  36  37  37  38  38  39
			 40  41  42  43  44  45  46  47
			 48  49  50  51  52  53  54  55
			 56  57  58  59  60  61  62  63
			 64  65  66  67  68  69  70  71
			 72  73  74  75  76  77  78  79
			 80  81  82  83  84  85  86  87
			 88  89  90  91  92  93  94  95
			 96  97  98  99 100 101 102 103
			104 105 106 107 108 109 110 111
			112 113 114 115 116 117 118 119
			120 121 122 123 124 125 126 127
			128 129 130 131 132 133 134 135
			136 137 138 139 140 141 142 143
			144 145 146 147 148 149 150 151
			152 153 154 155 156 157 158 159
			160 161 162 163 164 165 166 167
			168 169 170 171 172 173 174 175
			176 177 178 179 180 181 182 183
			184 185 186 187 188 189 190 191
			192 193 194 195 196 197 198 199
			200 201 202 203 204 205 206 207
			208 209 210 211 212 213 214 215
			216 217 218 219 220 221 222 223
			224 225 226 227 228 229 230 231
			232 233 234 235 236 237 238 239
			240 241 242 243 244 245 246 247
			248 249 250 251 252 253 254 255
		>;
		default-brightness-level = <200>;
	};

	hdmi0_sound: hdmi0-sound {
		status = "okay";
		compatible = "rockchip,hdmi";
		rockchip,mclk-fs = <128>;
		rockchip,card-name = "rockchip-hdmi0";
		rockchip,cpu = <&i2s5_8ch>;
		rockchip,codec = <&hdmi0>;
		rockchip,jack-det;
	};

	hdmi1_sound: hdmi1-sound {
        status = "okay";
        compatible = "rockchip,hdmi";
        rockchip,mclk-fs = <128>;
        rockchip,card-name = "rockchip-hdmi1";
        rockchip,cpu = <&i2s6_8ch>;
        rockchip,codec = <&hdmi1>;
        rockchip,jack-det;
        };
	
	vendor_storage_rm: vendor-storage-rm@0 {
		compatible = "rockchip,vendor-storage-rm";
		reg = <0x0 0x0 0x0 0x0>;
	};
	
	vendor_storage: vendor-storage {
		compatible = "rockchip,ram-vendor-storage";
		memory-region = <&vendor_storage_rm>;
		status = "okay";
	};

	vcc3v3_lcd: vcc3v3-lcd {
		compatible = "regulator-fixed";
		regulator-name = "vcc3v3_lcd";
		enable-active-high;
		gpio = <&gpio1 RK_PC4 GPIO_ACTIVE_HIGH>;
		vin-supply = <&vcc3v3_sys>;
		pinctrl-names = "default";
		pinctrl-0 = <&lcdpwr_en>;

	};
	
	dummy_codec: dummy-codec {
		status = "okay";
		compatible = "rockchip,dummy-codec";
		#sound-dai-cells = <0>;
		clocks = <&mclkout_i2s1>;
		clock-names = "mclk";
		assigned-clocks = <&mclkout_i2s1>;
		assigned-clock-rates = <12288000>;
		pinctrl-names = "default";
		pinctrl-0 = <&i2s1m0_mclk>;
	};
	
	hdmiin_sound: hdmiin-sound {
		status = "okay";
		compatible = "simple-audio-card";
		simple-audio-card,format = "i2s";
		simple-audio-card,name = "rockchip,hdmiin";
		simple-audio-card,mclk-fs = <256>;
		
		simple-audio-card,cpu {
			sound-dai = <&i2s1_8ch>;
		};
		simple-audio-card,codec {
			sound-dai = <&dummy_codec>;
		};
	};

	leds: leds {
		status = "okay";
		compatible = "gpio-leds";

		led_act: led_act {
                        label = "led-act";
			gpios = <&gpio3 RK_PB7 GPIO_ACTIVE_HIGH>;
			default-state = "off";
		};
	};

	vcc12v_dcin: vcc12v-dcin {
		compatible = "regulator-fixed";
		regulator-name = "vcc12v_dcin";
		regulator-always-on;
		regulator-boot-on;
		regulator-min-microvolt = <12000000>;
		regulator-max-microvolt = <12000000>;
	};

	vcc5v0_sys: vcc5v0-sys {
		compatible = "regulator-fixed";
		regulator-name = "vcc5v0_sys";
		regulator-always-on;
		regulator-boot-on;
		regulator-min-microvolt = <5000000>;
		regulator-max-microvolt = <5000000>;
		vin-supply = <&vcc12v_dcin>;
	};

	vcc3v3_sys: vcc3v3-sys {
		compatible = "regulator-fixed";
		regulator-name = "vcc3v3_sys";
		regulator-always-on;
		regulator-boot-on;
		regulator-min-microvolt = <3300000>;
		regulator-max-microvolt = <3300000>;
		vin-supply = <&vcc12v_dcin>;

	};

	vcc5v0_host: vcc5v0-host-regulator {
		compatible = "regulator-fixed";
		regulator-name = "vcc5v0_host";
		regulator-boot-on;
		regulator-always-on;
		regulator-min-microvolt = <5000000>;
		regulator-max-microvolt = <5000000>;
		enable-active-high;
		gpio = <&gpio1 RK_PD5 GPIO_ACTIVE_HIGH>;
		vin-supply = <&vcc5v0_sys>;
		pinctrl-names = "default";
		pinctrl-0 = <&vcc5v0_host1_en>;
	};

	vcc5v0_otg: vcc5v0-otg-regulator {
		compatible = "regulator-fixed";
		regulator-name = "vcc5v0_otg";
		regulator-min-microvolt = <5000000>;
		regulator-max-microvolt = <5000000>;
		regulator-boot-on;
		regulator-always-on;
		enable-active-high;
		gpios = <&gpio0 RK_PA0 GPIO_ACTIVE_HIGH>;
		vin-supply = <&vcc5v0_sys>;
		pinctrl-names = "default";
		pinctrl-0 = <&typec5v_pwren>;
	};
	
	vcc_mipidphy0: vcc-mipi-dphy0 {
		compatible = "regulator-fixed";
		regulator-name = "vcc_mipidphy0";
		regulator-min-microvolt = <5000000>;
		regulator-max-microvolt = <5000000>;
		regulator-boot-on;
		regulator-always-on;
		enable-active-high;
		gpios = <&gpio4 RK_PC6 GPIO_ACTIVE_HIGH>;
		vin-supply = <&vcc5v0_sys>;
		pinctrl-names = "default";
		pinctrl-0 = <&cam_en>;
	};

    vcc_1v1_nldo_s3: vcc-1v1-nldo-s3 {
            compatible = "regulator-fixed";
            regulator-name = "vcc_1v1_nldo_s3";
            regulator-always-on;
            regulator-boot-on;
            regulator-min-microvolt = <1100000>;
            regulator-max-microvolt = <1100000>;
            vin-supply = <&vcc5v0_sys>;
    };
	
	ext_cam_clk: external-camera-clock {
		compatible = "fixed-clock";
		clock-frequency = <24000000>;
		clock-output-names = "CLK_CAMERA_24MHZ";
		#clock-cells = <0>;
	};
};

&cpu_l0 {
	cpu-supply = <&vdd_cpu_lit_s0>;
	mem-supply = <&vdd_cpu_lit_mem_s0>;
};

&cpu_b0 {
	cpu-supply = <&vdd_cpu_big0_s0>;
	mem-supply = <&vdd_cpu_big0_mem_s0>;
};

&cpu_b2 {
	cpu-supply = <&vdd_cpu_big1_s0>;
	mem-supply = <&vdd_cpu_big1_mem_s0>;
};

&dfi {
	status = "okay";
};

&dmc {
	auto-freq-en = <1>;
	status = "okay";
};

&sdhci {
	bus-width = <8>;
	no-sdio;
	no-sd;
	non-removable;
	max-frequency = <200000000>;
	mmc-hs400-1_8v;
	mmc-hs400-enhanced-strobe;
	status = "okay";
};

&dsi0 {
	status = "disabled";
	//rockchip,lane-rate = <1000>;
	dsi0_panel: panel@0 {
		status = "okay";
		compatible = "simple-panel-dsi";
		reg = <0>;
		backlight = <&backlight>;
		reset-delay-ms = <10>;
		enable-delay-ms = <10>;
		prepare-delay-ms = <10>;
		unprepare-delay-ms = <10>;
		disable-delay-ms = <60>;
		width-mm = <136>;
		height-mm = <217>;
		dsi,flags = <(MIPI_DSI_MODE_VIDEO | MIPI_DSI_MODE_VIDEO_BURST |
			MIPI_DSI_MODE_LPM | MIPI_DSI_MODE_NO_EOT_PACKET)>;
		dsi,format = <MIPI_DSI_FMT_RGB888>;
		dsi,lanes  = <4>;

		panel-init-sequence = [	
			//2025 07 29  10.1
			
			29 00 04 FF 98 81 03

			//GIP_1

			13 00 02 01 00
			13 00 02 02 00
			13 00 02 03 53
			13 00 02 04 D3
			13 00 02 05 00
			13 00 02 06 0D
			13 00 02 07 08
			13 00 02 08 00
			13 00 02 09 00
			13 00 02 0a 00
			13 00 02 0b 00
			13 00 02 0c 00
			13 00 02 0d 00
			13 00 02 0e 00
			13 00 02 0f 28
			13 00 02 10 28
			13 00 02 11 00
			13 00 02 12 00
			13 00 02 13 00
			13 00 02 14 00
			13 00 02 15 00
			13 00 02 16 00
			13 00 02 17 00
			13 00 02 18 00
			13 00 02 19 00
			13 00 02 1a 00
			13 00 02 1b 00
			13 00 02 1c 00
			13 00 02 1d 00
			13 00 02 1e 40
			13 00 02 1f 80
			13 00 02 20 06
			13 00 02 21 01
			13 00 02 22 00
			13 00 02 23 00
			13 00 02 24 00
			13 00 02 25 00
			13 00 02 26 00
			13 00 02 27 00
			13 00 02 28 33
			13 00 02 29 33
			13 00 02 2a 00
			13 00 02 2b 00
			13 00 02 2c 00
			13 00 02 2d 00
			13 00 02 2e 00
			13 00 02 2f 00
			13 00 02 30 00
			13 00 02 31 00
			13 00 02 32 00
			13 00 02 33 00
			13 00 02 34 03
			13 00 02 35 00
			13 00 02 36 00
			13 00 02 37 00
			13 00 02 38 96
			13 00 02 39 00
			13 00 02 3a 00
			13 00 02 3b 00
			13 00 02 3c 00
			13 00 02 3d 00
			13 00 02 3e 00
			13 00 02 3f 00
			13 00 02 40 00
			13 00 02 41 00
			13 00 02 42 00
			13 00 02 43 00
			13 00 02 44 00

			//GIP_2
			13 00 02 50 00
			13 00 02 51 23
			13 00 02 52 45
			13 00 02 53 67
			13 00 02 54 89
			13 00 02 55 AB
			13 00 02 56 01
			13 00 02 57 23
			13 00 02 58 45
			13 00 02 59 67
			13 00 02 5a 89
			13 00 02 5b AB
			13 00 02 5c CD
			13 00 02 5d EF

			//GIP_3
			13 00 02 5e 00
			13 00 02 5f 08
			13 00 02 60 08
			13 00 02 61 06
			13 00 02 62 06
			13 00 02 63 01
			13 00 02 64 01
			13 00 02 65 00
			13 00 02 66 00
			13 00 02 67 02
			13 00 02 68 15
			13 00 02 69 15
			13 00 02 6a 14
			13 00 02 6b 14
			13 00 02 6c 0D
			13 00 02 6d 0D
			13 00 02 6e 0C
			13 00 02 6f 0C
			13 00 02 70 0F
			13 00 02 71 0F
			13 00 02 72 0E
			13 00 02 73 0E
			13 00 02 74 02
			  
			13 00 02 75 08
			13 00 02 76 08
			13 00 02 77 06
			13 00 02 78 06
			13 00 02 79 01
			13 00 02 7a 01
			13 00 02 7b 00
			13 00 02 7c 00
			13 00 02 7d 02
			13 00 02 7e 15
			13 00 02 7f 15
			13 00 02 80 14
			13 00 02 81 14
			13 00 02 82 0D
			13 00 02 83 0D
			13 00 02 84 0C
			13 00 02 85 0C
			13 00 02 86 0F
			13 00 02 87 0F
			13 00 02 88 0E
			13 00 02 89 0E
			13 00 02 8A 02

			//CMD_Page 
			29 00 04 FF 98 81 04

			//13 00 02 2F 01//////BIST MODE

			13 00 02 C5 3A

			13 00 02 6E 2B
			13 00 02 6F 37
			13 00 02 3A 24
			13 00 02 8D 1A
			13 00 02 87 BA
			13 00 02 B2 D1
			13 00 02 88 0B
			13 00 02 38 01
			13 00 02 39 00
			13 00 02 B5 02
			13 00 02 31 25
			13 00 02 3B 98
						
			//CMD_Page 
			29 00 04 FF 98 81 01
			13 00 02 22 0A
			13 00 02 31 00
			13 00 02 53 53//VCOM
			13 00 02 55 53
			//13 00 02 56 00
			13 00 02 50 85
			13 00 02 51 80
			13 00 02 60 06
			13 00 02 62 20

			//=========Gamma START=============
			//Pos Regis
			13 00 02 A0 00
			13 00 02 A1 21
			13 00 02 A2 35
			13 00 02 A3 19
			13 00 02 A4 1E
			13 00 02 A5 33
			13 00 02 A6 27
			13 00 02 A7 26
			13 00 02 A8 AF
			13 00 02 A9 1B
			13 00 02 AA 27
			13 00 02 AB 8D
			13 00 02 AC 1A
			13 00 02 AD 1B
			13 00 02 AE 50
			13 00 02 AF 26
			13 00 02 B0 2B
			13 00 02 B1 54
			13 00 02 B2 5E
			13 00 02 B3 23

			//Neg Regis
			13 00 02 C0 00
			13 00 02 C1 21
			13 00 02 C2 35
			13 00 02 C3 19
			13 00 02 C4 1E
			13 00 02 C5 33
			13 00 02 C6 27
			13 00 02 C7 26
			13 00 02 C8 AF
			13 00 02 C9 1B
			13 00 02 CA 27
			13 00 02 CB 8D
			13 00 02 CC 1A
			13 00 02 CD 1B
			13 00 02 CE 50
			13 00 02 CF 26
			13 00 02 D0 2B
			13 00 02 D1 54
			13 00 02 D2 5E
			13 00 02 D3 23

			//========= Gamma END===========
			//CMD_Page 		
			29 00 04 FF 98 81 00
			
			05 78 01 11
			05 1E 01 29
		];
		
		panel-exit-sequence = [
			05 00 01 28
			05 00 01 10
		];

		disp_timings0: display-timings {
			native-mode = <&dsi0_timing0>;
			dsi0_timing0: timing0 {
				clock-frequency = <70000000>;
				hactive = <800>;
				vactive = <1280>;
				hfront-porch = <20>;
				hsync-len = <20>;
				hback-porch = <40>;
				vfront-porch = <20>;
				vsync-len = <4>;
				vback-porch = <20>;
				hsync-active = <0>;
				vsync-active = <0>;
				de-active = <0>;
				pixelclk-active = <0>;
			};
			/*dsi0_timing0: timing0 {//liushuming add
				clock-frequency = <148500000>;
				hactive = <1920>;
				vactive = <1080>;
				hfront-porch = <140>;
				hsync-len = <40>;
				hback-porch = <100>;
				vfront-porch = <15>;
				vsync-len = <20>;
				vback-porch = <10>;
				hsync-active = <0>;
				vsync-active = <0>;
				de-active = <0>;
				pixelclk-active = <0>;
			};*/
		};

		ports {
			#address-cells = <1>;
			#size-cells = <0>;

			port@0 {
				reg = <0>;
				panel_in_dsi: endpoint {
					remote-endpoint = <&dsi_out_panel>;
				};
			};
		};
	};

	ports {
		#address-cells = <1>;
		#size-cells = <0>;

		port@1 {
			reg = <1>;
			dsi_out_panel: endpoint {
				remote-endpoint = <&panel_in_dsi>;
			};
		};
	};

};

&dsi0_in_vp2 {
	status = "disabled";
};

&dsi0_in_vp3 {
	status = "okay";
};


&route_dsi0 {
	status = "okay";
	connect = <&vp3_out_dsi0>;
};

&gpu {
	mali-supply = <&vdd_gpu_s0>;
	mem-supply = <&vdd_gpu_mem_s0>;
	status = "okay";
};

&gpu_mali {
	mali-supply = <&vdd_gpu_s0>;
	mem-supply = <&vdd_gpu_mem_s0>;
	status = "okay";
};

&iep {
	status = "okay";
};

&iep_mmu {
	status = "okay";
};

&jpegd {
	status = "okay";
};

&jpegd_mmu {
	status = "okay";
};

&jpege_ccu {
	status = "okay";
};

&jpege0 {
	status = "okay";
};

&jpege0_mmu {
	status = "okay";
};

&jpege1 {
	status = "okay";
};

&jpege1_mmu {
	status = "okay";
};

&jpege2 {
	status = "okay";
};

&jpege2_mmu {
	status = "okay";
};

&jpege3 {
	status = "okay";
};

&jpege3_mmu {
	status = "okay";
};

&mpp_srv {
	status = "okay";
};

&rga3_core0 {
	status = "okay";
};

&rga3_0_mmu {
	status = "okay";
};

&rga3_core1 {
	status = "okay";
};

&rga3_1_mmu {
	status = "okay";
};

&rga2 {
	status = "okay";
};

&rknpu {
	rknpu-supply = <&vdd_npu_s0>;
	mem-supply = <&vdd_npu_mem_s0>;
	status = "okay";
};

&rknpu_mmu {
	status = "okay";
};

&rkvdec_ccu {
	status = "okay";
};

&rkvdec0 {
	status = "okay";
};

&rkvdec0_mmu {
	status = "okay";
};

&rkvdec1 {
	status = "okay";
};

&rkvdec1_mmu {
	status = "okay";
};

&rkvenc_ccu {
	status = "okay";
};

&rkvenc0 {
	status = "okay";
};

&rkvenc0_mmu {
	status = "okay";
};

&rkvenc1 {
	status = "okay";
};

&rkvenc1_mmu {
	status = "okay";
};

&rockchip_suspend {
	status = "okay";
	rockchip,sleep-debug-en = <1>;
};

&saradc {
	status = "okay";
	vref-supply = <&vcc_1v8_s0>;
};

&tsadc {
	status = "okay";
};

&u2phy0 {
	status = "okay";
};

&u2phy1 {
	status = "okay";
};

&u2phy2 {
	status = "okay";
};

&u2phy3 {
	status = "okay";
};

&u2phy0_otg {
	vbus-supply = <&vcc5v0_otg>;
	status = "okay";
};

&u2phy1_otg {
	phy-supply = <&vcc5v0_host>;
	status = "okay";
};

&u2phy2_host {
	phy-supply = <&vcc5v0_host>;
	status = "okay";
};

&u2phy3_host {
	phy-supply = <&vcc5v0_host>;
	status = "okay";
};

&usb_host0_ehci {
	status = "okay";
};

&usb_host0_ohci {
	status = "okay";
};

&usb_host1_ehci {
	status = "okay";
};

&usb_host1_ohci {
	status = "okay";
};

&usbdp_phy0 {
        rockchip,dp-lane-mux = < 0 1 >;
        status = "okay";
};

&usbdp_phy0_dp {
        status = "disabled";
};

&usbdp_phy0_u3 {
        status = "okay";
};

&usbdp_phy1 {
        rockchip,dp-lane-mux = < 2 3 >;
        status = "okay";
};

&usbdp_phy1_dp {
        status = "disabled";
};

&usbdp_phy1_u3 {
        status = "okay";
};

&usbdrd3_0 {
        status = "okay";
};

&usbdrd_dwc3_0 {
        dr_mode = "host";
        status = "okay";
};

&usbdrd3_1 {
	status = "okay";
};

&usbdrd_dwc3_1 {
	status = "okay";
};

&vdpu {
	status = "okay";
};

&vdpu_mmu {
	status = "okay";
};

&vop {
	status = "okay";
};

&vop_mmu {
	status = "okay";
};

/* vp0 & vp1 splice for 8K output */
&vp0 {
	cursor-win-id=<ROCKCHIP_VOP2_CLUSTER0>;
	rockchip,plane-mask = <(1 << ROCKCHIP_VOP2_CLUSTER0 | 1 << ROCKCHIP_VOP2_ESMART0)>;
	rockchip,primary-plane = <ROCKCHIP_VOP2_ESMART0>;
};

&vp1 {
	cursor-win-id=<ROCKCHIP_VOP2_CLUSTER1>;
	rockchip,plane-mask = <(1 << ROCKCHIP_VOP2_CLUSTER1 | 1 << ROCKCHIP_VOP2_ESMART1)>;
	rockchip,primary-plane = <ROCKCHIP_VOP2_ESMART1>;
};

&vp2 {
	cursor-win-id=<ROCKCHIP_VOP2_CLUSTER2>;
	rockchip,plane-mask = <(1 << ROCKCHIP_VOP2_CLUSTER2 | 1 << ROCKCHIP_VOP2_ESMART2)>;
	rockchip,primary-plane = <ROCKCHIP_VOP2_ESMART2>;
};

&vp3 {
	cursor-win-id=<ROCKCHIP_VOP2_CLUSTER3>;
	rockchip,plane-mask = <(1 << ROCKCHIP_VOP2_CLUSTER3 | 1 << ROCKCHIP_VOP2_ESMART3)>;
	rockchip,primary-plane = <ROCKCHIP_VOP2_ESMART3>;
};

&backlight {
	pwms = <&pwm2 0 25000 0>;
	enable-gpios = <&gpio4 RK_PA3 GPIO_ACTIVE_HIGH>;
	pinctrl-names = "default";
	pinctrl-0 = <&bl_en>;	
	status = "okay";
};

&gmac0 {
	/* Use rgmii-rxid mode to disable rx delay inside Soc */
	phy-mode = "rgmii-rxid";
	clock_in_out = "output";

	snps,reset-gpio = <&gpio4 RK_PB3 GPIO_ACTIVE_LOW>;
	snps,reset-active-low;
	/* Reset time is 20ms, 100ms for rtl8211f */
	snps,reset-delays-us = <0 20000 100000>;

	pinctrl-names = "default";
	pinctrl-0 = <&gmac0_miim
		     &gmac0_tx_bus2
		     &gmac0_rx_bus2
		     &gmac0_rgmii_clk
		     &gmac0_rgmii_bus>;

	tx_delay = <0x44>;
	/* rx_delay = <0x3f>; */

	phy-handle = <&rgmii_phy>;
	status = "okay";
};

&hdmi0 {
	enable-gpios = <&gpio4 RK_PB0 GPIO_ACTIVE_HIGH>;
	status = "okay";
};

&hdmi0_in_vp0 {
	status = "okay";
};

&hdptxphy_hdmi0 {
	status = "okay";
};

&hdmi1 {
	enable-gpios = <&gpio4 RK_PB2 GPIO_ACTIVE_HIGH>;
	pinctrl-names = "default";
	pinctrl-0 = <&hdmim0_tx1_hpd &hdmim1_tx1_scl &hdmim1_tx1_sda>;
    status = "okay";
};

&hdmi1_in_vp1 {
        status = "okay";
};

&hdptxphy_hdmi1 {
	status = "okay";
};

&i2c0 {
	status = "okay";
	pinctrl-names = "default";
	pinctrl-0 = <&i2c0m2_xfer>;

	vdd_cpu_big0_s0: vdd_cpu_big0_mem_s0: rk8602@42 {
		compatible = "rockchip,rk8602";
		reg = <0x42>;
		vin-supply = <&vcc5v0_sys>;
		regulator-compatible = "rk860x-reg";
		regulator-name = "vdd_cpu_big0_s0";
		regulator-min-microvolt = <550000>;
		regulator-max-microvolt = <1050000>;
		regulator-ramp-delay = <2300>;
		rockchip,suspend-voltage-selector = <1>;
		regulator-boot-on;
		regulator-always-on;
		regulator-state-mem {
			regulator-off-in-suspend;
		};
	};

	vdd_cpu_big1_s0: vdd_cpu_big1_mem_s0: rk8603@43 {
		compatible = "rockchip,rk8603";
		reg = <0x43>;
		vin-supply = <&vcc5v0_sys>;
		regulator-compatible = "rk860x-reg";
		regulator-name = "vdd_cpu_big1_s0";
		regulator-min-microvolt = <550000>;
		regulator-max-microvolt = <1050000>;
		regulator-ramp-delay = <2300>;
		rockchip,suspend-voltage-selector = <1>;
		regulator-boot-on;
		regulator-always-on;
		regulator-state-mem {
			regulator-off-in-suspend;
		};
	};
};

&i2c2 {
	status = "okay";

	vdd_npu_s0: vdd_npu_mem_s0: rk8602@42 {
		compatible = "rockchip,rk8602";
		reg = <0x42>;
		vin-supply = <&vcc5v0_sys>;
		regulator-compatible = "rk860x-reg";
		regulator-name = "vdd_npu_s0";
		regulator-min-microvolt = <550000>;
		regulator-max-microvolt = <950000>;
		regulator-ramp-delay = <2300>;
		rockchip,suspend-voltage-selector = <1>;
		regulator-boot-on;
		regulator-always-on;
		regulator-state-mem {
			regulator-off-in-suspend;
		};
	};
};

&i2c3 {
	status = "okay";
	pinctrl-names = "default";
	pinctrl-0 = <&i2c3m1_xfer>;

	lt7911uxc2: lt7911uxc2@43 {
		status = "okay";
		reg = <0x43>;
		compatible = "lontium,lt7911uxc2";
		clocks = <&ext_cam_clk>;
		clock-names = "xvclk";
		
		pinctrl-names = "default";
		pinctrl-0 = <&lt7911uxc2_pin_1>;
		interrupt-parent = <&gpio1>;
		interrupts = <RK_PC6 IRQ_TYPE_LEVEL_LOW>;
		
		plugin-det-gpios = <&gpio1 RK_PD2 GPIO_ACTIVE_LOW>;
	    reset-gpios = <&gpio1 RK_PD3 GPIO_ACTIVE_HIGH>;			
		rockchip,camera-module-index = <0>;
		rockchip,camera-module-facing = "back";
		rockchip,camera-module-name = "LT7911UXC2-HDMI2";
		rockchip,camera-module-lens-name = "LT7911UXC2";

		port {
			lt7911uxc_hdmi2_out: endpoint {
				remote-endpoint = <&hdmi2_mipi1_in>;
				data-lanes = <1 2 3 4>;
			};
		};
	};
};

&i2c4 {
	status = "okay";
	pinctrl-names = "default";
	pinctrl-0 = <&i2c4m3_xfer>;
 
	lt6911uxeHDMI4: lt6911uxeHDMI4@2b {
		compatible = "lontium,lt6911uxeHDMI4";
		status = "okay";
		reg = <0x2b>;
		clocks = <&ext_cam_clk>;
		clock-names = "xvclk";
		power-domains = <&power RK3588_PD_VI>;
		pinctrl-names = "default";
		
		pinctrl-0 = <&lt6911uxe2_pin_1>;
		interrupt-parent = <&gpio3>;
		interrupts = <RK_PD5 IRQ_TYPE_LEVEL_LOW>;
		
		reset-gpios = <&gpio3 RK_PC1 GPIO_ACTIVE_HIGH>;
		plugin-det-gpios = <&gpio3 RK_PD4 GPIO_ACTIVE_HIGH>;
		
		rockchip,camera-module-index = <0>;
		rockchip,camera-module-facing = "back";
		rockchip,camera-module-name = "lt6911uxeHDMI4";
		rockchip,camera-module-lens-name = "lt6911uxeHDMI4";
		
		port {
			lt6911uxe_hdmi4_out: endpoint {
				remote-endpoint = <&hdmi4_mipi4_in>;
				data-lanes = <1 2 3 4>;
			};
		};
	};
};

&i2c6 {
	status = "okay";
	hym8563: hym8563@51 {
		compatible = "haoyu,hym8563";
		reg = <0x51>;
		#clock-cells = <0>;
		clock-frequency = <32768>;
		clock-output-names = "hym8563";
		pinctrl-names = "default";
		pinctrl-0 = <&hym8563_int>;
		interrupt-parent = <&gpio0>;
		interrupts = <RK_PD4 IRQ_TYPE_LEVEL_LOW>;
		wakeup-source;
	};
};

&i2c7 {
	status = "okay";
	pinctrl-names = "default";
	pinctrl-0 = <&i2c7m2_xfer>;
	
	lt6911uxe1: lt6911uxe1@2b {
		status = "okay";
		reg = <0x2b>;
		compatible = "lontium,lt6911uxe1";
		clocks = <&ext_cam_clk>;
		clock-names = "xvclk";
		
		pinctrl-names = "default";
		pinctrl-0 = <&lt6911uxe1_pin_1>;
		interrupt-parent = <&gpio4>;
		interrupts = <RK_PB6 IRQ_TYPE_LEVEL_LOW>;
		
		plugin-det-gpios = <&gpio4 RK_PB1 GPIO_ACTIVE_LOW>;
	    reset-gpios = <&gpio4 RK_PC6 GPIO_ACTIVE_HIGH>;			
		rockchip,camera-module-index = <0>;
		rockchip,camera-module-facing = "back";
		rockchip,camera-module-name = "lt6911uxe1";
		rockchip,camera-module-lens-name = "lt6911uxe1";

		port {
			lt6911uxe_hdmi3_out: endpoint {
				remote-endpoint = <&hdmi3_mipi2_in>;
				data-lanes = <1 2 3 4>;
			};
		};
	};
};

&i2c8 {
	status = "okay";
	pinctrl-names = "default";
	pinctrl-0 = <&i2c8m4_xfer>;

	lt7911uxc1: lt7911uxc1@43 {
		status = "okay";
		reg = <0x43>;
		compatible = "lontium,lt7911uxc1";
		clocks = <&ext_cam_clk>;
		clock-names = "xvclk";
		
		pinctrl-names = "default";
		pinctrl-0 = <&lt7911uxc1_pin_1>;
		interrupt-parent = <&gpio3>;
		interrupts = <RK_PB2 IRQ_TYPE_LEVEL_LOW>;
		
		plugin-det-gpios = <&gpio3 RK_PB3 GPIO_ACTIVE_LOW>;
	    reset-gpios = <&gpio3 RK_PB4 GPIO_ACTIVE_HIGH>;			
		rockchip,camera-module-index = <0>;
		rockchip,camera-module-facing = "back";
		rockchip,camera-module-name = "LT7911UXC1-HDMI1";
		rockchip,camera-module-lens-name = "LT7911UXC1";

		port {
			lt7911uxc_hdmi1_out: endpoint {
				remote-endpoint = <&hdmi1_mipi0_in>;
				data-lanes = <1 2 3 4>;
			};
		};
	};
};

&i2s1_8ch {
	status = "okay";
	rockchip,i2s-rx-route =<0 1 2 3>;
	pinctrl-names = "default";
	pinctrl-0 = <&i2s1m0_lrck
		    &i2s1m0_sclk
		    &i2s1m0_sdi0
			&i2s1m0_sdi1
			&i2s1m0_sdi2
		    &i2s1m0_sdi3>;
};

&spdif_tx2 {
	status = "okay";
};
&spdif_tx5 {
	status = "okay";
};
&i2s5_8ch {
	status = "okay";
};

&i2s6_8ch {
	status = "okay";
};

&i2s7_8ch {
	status = "okay";
};

&mdio0 {
	rgmii_phy: phy@1 {
		compatible = "ethernet-phy-ieee802.3-c22";
		reg = <0x1>;
	};
};

&mipi_dcphy0 {
	status = "disabled";
};

&mipi_dcphy1 {
	status = "disabled";
};

&combphy0_ps {
    status = "okay";
};

&combphy1_ps {
    status = "okay";
};

&combphy2_psu {
	status = "okay";
};

&pwm2 {
	status = "okay";
};

&uart2 {
	status = "okay";
	pinctrl-names = "default";
	pinctrl-0 = <&uart2m0_xfer>;
};

&display_subsystem {
	memory-region = <&drm_logo>;
	memory-region-names = "drm-logo";
};

&rng {
	status = "okay";
};

&sfc {
	status = "okay";
	max-freq = <50000000>;
	#address-cells = <1>;
	#size-cells = <0>;
	pinctrl-names = "default";
	pinctrl-0 = <&fspim2_pins>;

	spi_flash: spi-flash@0 {
		#address-cells = <1>;
		#size-cells = <0>;
		compatible = "jedec,spi-nor";
		reg = <0x0>;
		spi-max-frequency = <50000000>;
		spi-tx-bus-width = <1>;
		spi-rx-bus-width = <4>;
		status = "okay";
	};
};

&csi2_dphy0_hw {
    status = "okay";
};

&csi2_dphy1_hw {
    status = "okay";
};



&mipi_dcphy0 {
	status = "okay";
};

&mipi_dcphy1 {
	status = "okay";
};

&csi2_dphy0 {
    status = "okay";

    ports {
        #address-cells = <1>;
        #size-cells = <0>;
        port@0 {
            reg = <0>;
            #address-cells = <1>;
            #size-cells = <0>;

            hdmi3_mipi2_in: endpoint@1 {
                reg = <1>;
                remote-endpoint = <&lt6911uxe_hdmi3_out>;
                data-lanes = <1 2 3 4>;
            };
        };
        
        port@1 {
            reg = <1>;
            #address-cells = <1>;
            #size-cells = <0>;

            csidphy0_out: endpoint@0 {
                reg = <0>;
                remote-endpoint = <&mipi2_csi2_input>;//data->To-mipi 0
            };
        };
    };
};



&csi2_dphy3 {
    status = "okay";

    ports {
        #address-cells = <1>;
        #size-cells = <0>;
        port@0 {
            reg = <0>;
            #address-cells = <1>;
            #size-cells = <0>;

            hdmi4_mipi4_in: endpoint@1 {
                reg = <1>;
                remote-endpoint = <&lt6911uxe_hdmi4_out>;
                data-lanes = <1 2 3 4>;
            };
        };
        
        //full mode and split mode
        port@1 {
            reg = <1>;
            #address-cells = <1>;
            #size-cells = <0>;

            csidphy1_out: endpoint@0 {
                reg = <0>;
                remote-endpoint = <&mipi4_csi2_input>;
            };
        };
    };
};


&csi2_dcphy0 {
    status = "okay";

    ports {
        #address-cells = <1>;
        #size-cells = <0>;
        port@0 {
            reg = <0>;
            #address-cells = <1>;
            #size-cells = <0>;

            hdmi1_mipi0_in: endpoint@1 {
                reg = <1>;
                remote-endpoint = <&lt7911uxc_hdmi1_out>;
                data-lanes = <1 2 3 4>;
            };
        };
        
        //full mode and split mode
        port@1 {
            reg = <1>;
            #address-cells = <1>;
            #size-cells = <0>;

            csidcphy0_out: endpoint@0 {
                reg = <0>;
                remote-endpoint = <&mipi0_csi2_input>;
            };
        };
    };
};

&csi2_dcphy1 {
    status = "okay";

    ports {
        #address-cells = <1>;
        #size-cells = <0>;
        port@0 {
            reg = <0>;
            #address-cells = <1>;
            #size-cells = <0>;

            hdmi2_mipi1_in: endpoint@1 {
                reg = <1>;
                remote-endpoint = <&lt7911uxc_hdmi2_out>;
                data-lanes = <1 2 3 4>;
            };
        };
        
        //full mode and split mode
        port@1 {
            reg = <1>;
            #address-cells = <1>;
            #size-cells = <0>;

            csidcphy1_out: endpoint@0 {
                reg = <0>;
                remote-endpoint = <&mipi1_csi2_input>;
            };
        };
    };
};

&mipi0_csi2 {
    status = "okay";

    ports {
        #address-cells = <1>;
        #size-cells = <0>;

        port@0 {
            reg = <0>;
            #address-cells = <1>;
            #size-cells = <0>;

            mipi0_csi2_input: endpoint@1 {
                reg = <1>;
                remote-endpoint = <&csidcphy0_out>;
            };
        };

        port@1 {
            reg = <1>;
            #address-cells = <1>;
            #size-cells = <0>;

            mipi0_csi2_output: endpoint@0 {
                reg = <0>;
                remote-endpoint = <&cif_mipi0_in>;
            };
        };
    };
};

&mipi1_csi2 {
    status = "okay";

    ports {
        #address-cells = <1>;
        #size-cells = <0>;

        port@0 {
            reg = <0>;
            #address-cells = <1>;
            #size-cells = <0>;

            mipi1_csi2_input: endpoint@1 {
                reg = <1>;
                remote-endpoint = <&csidcphy1_out>;
            };
        };

        port@1 {
            reg = <1>;
            #address-cells = <1>;
            #size-cells = <0>;

            mipi1_csi2_output: endpoint@0 {
                reg = <0>;
                remote-endpoint = <&cif_mipi1_in>;
            };
        };
    };
};

&mipi2_csi2 {
    status = "okay";

    ports {
        #address-cells = <1>;
        #size-cells = <0>;

        port@0 {
            reg = <0>;
            #address-cells = <1>;
            #size-cells = <0>;

            mipi2_csi2_input: endpoint@1 {
                reg = <1>;
                remote-endpoint = <&csidphy0_out>;
            };
        };

        port@1 {
            reg = <1>;
            #address-cells = <1>;
            #size-cells = <0>;

            mipi2_csi2_output: endpoint@0 {
                reg = <0>;
                remote-endpoint = <&cif_mipi2_in>;
            };
        };
    };
};



&mipi4_csi2 {
    status = "okay";

    ports {
        #address-cells = <1>;
        #size-cells = <0>;

        port@0 {
            reg = <0>;
            #address-cells = <1>;
            #size-cells = <0>;

            mipi4_csi2_input: endpoint@1 {
                reg = <1>;
                remote-endpoint = <&csidphy1_out>;
            };
        };

        port@1 {
            reg = <1>;
            #address-cells = <1>;
            #size-cells = <0>;

            mipi4_csi2_output: endpoint@0 {
                reg = <0>;
                remote-endpoint = <&cif_mipi4_in>;
            };
        };
    };
};

&rkcif {
	status = "okay";
};

&rkcif_mipi_lvds {
	status = "okay";

	port {
		cif_mipi0_in: endpoint {
			remote-endpoint = <&mipi0_csi2_output>;
			data-lanes = <1 2 3 4>;
		};
	};
};

&rkcif_mipi_lvds1 {
	status = "okay";

	port {
		cif_mipi1_in: endpoint {
			remote-endpoint = <&mipi1_csi2_output>;
			data-lanes = <1 2 3 4>;
		};
	};
};

&rkcif_mipi_lvds2 {
	status = "okay";
	port {
		cif_mipi2_in: endpoint {
			remote-endpoint = <&mipi2_csi2_output>;
			data-lanes = <1 2 3 4>;
		};
	};
};

&rkcif_mipi_lvds4 {
	status = "okay";
	port {
		cif_mipi4_in: endpoint {
			remote-endpoint = <&mipi4_csi2_output>;
			data-lanes = <1 2 3 4>;
		};
	};
};

&rkcif_mmu {
	status = "okay";
};

&pinctrl {

	hdmiin {
		lt6911uxe1_pin_1: lt6911uxe1-pin-1 {
			rockchip,pins = <4 RK_PC6 RK_FUNC_GPIO &pcfg_pull_none>,
					        <4 RK_PB1 RK_FUNC_GPIO &pcfg_pull_none>;
		};
		lt6911uxe2_pin_1: lt6911uxe2-pin-1 {
			rockchip,pins = <3 RK_PC1 RK_FUNC_GPIO &pcfg_pull_none>,
					        <3 RK_PD4 RK_FUNC_GPIO &pcfg_pull_none>;
		};
        lt7911uxc1_pin_1: lt7911uxc1-pin-1 {
			rockchip,pins = <3 RK_PB3 RK_FUNC_GPIO &pcfg_pull_none>,
					        <3 RK_PB4 RK_FUNC_GPIO &pcfg_pull_none>;
		};
        lt7911uxc2_pin_1: lt7911uxc2-pin-1 {
			rockchip,pins = <1 RK_PD2 RK_FUNC_GPIO &pcfg_pull_none>,
					        <1 RK_PD3 RK_FUNC_GPIO &pcfg_pull_none>;
		};
		
	};

	hym8563 {
		hym8563_int: hym8563-int {
			rockchip,pins = <0 RK_PD4 RK_FUNC_GPIO &pcfg_pull_up>;
		};
	};

	rtl8111 {
		rtl8111_isolate: rtl8111-isolate {
			rockchip,pins = <1 RK_PA4 RK_FUNC_GPIO &pcfg_pull_up>;
		};
	};

	usb {
		vcc5v0_host1_en: vcc5v0-host1-en {
			rockchip,pins = <1 RK_PD5 RK_FUNC_GPIO &pcfg_pull_up>;
		};
	};

	usb-typec {
		typec5v_pwren: typec5v-pwren {
			rockchip,pins = <0 RK_PA0 RK_FUNC_GPIO &pcfg_pull_up>;
		};
	};

	hdmi {
		hdmirx_det: hdmirx-det {
			rockchip,pins = <2 RK_PB5 RK_FUNC_GPIO &pcfg_pull_up>;
		};
	};
	
	wifi {
		wifi_pwron: wifi-pwron {
			rockchip,pins = <3 RK_PB1 RK_FUNC_GPIO &pcfg_pull_up>;
		};
		bt_pwron: bt-pwron {
			rockchip,pins = <3 RK_PA6 RK_FUNC_GPIO &pcfg_pull_up>;
		};
	};
	
	lcd {
		lcdpwr_en: lcdpwr-en {
			rockchip,pins = <1 RK_PC4 RK_FUNC_GPIO &pcfg_pull_down>;
		};
		bl_en: bl-en {
			rockchip,pins = <4 RK_PA3 RK_FUNC_GPIO &pcfg_pull_none>;
		};
	};
	
	cam {
		cam_en: cam-en {
            rockchip,pins = <4 RK_PC6 RK_FUNC_GPIO &pcfg_output_high>;
        };
    };
};

